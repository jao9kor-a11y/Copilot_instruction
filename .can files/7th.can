/*@!Encoding:1252*/
includes
{

}

variables
{

}

on start
{
  write("CAPL script active. Waiting for message 0x123 to read EngineSpeed...");
}

/*
  This event is triggered when a message with ID 0x123 is received.
*/
on message 0x123
{
  long rawValue;
  double physicalValue;

  // --- MANUAL SIGNAL DECODING ---
  // This is an EXAMPLE. You must change this to match your actual signal definition.
  // This example assumes EngineSpeed is a 16-bit value in the first two bytes (Byte 0 and Byte 1).
  // It assumes a factor of 0.25 and an offset of 0.

  // Combine Byte 1 and Byte 0 into a 16-bit integer (assuming little-endian format)
  rawValue = (this.byte(1) << 8) | this.byte(0);

  // Apply the factor and offset to get the physical value
  physicalValue = rawValue * 0.25 + 0;

  write("Message 0x123 received: Manual EngineSpeed = %.2f rpm", physicalValue);
}
